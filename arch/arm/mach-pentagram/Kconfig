## configs/sp7350_emmc_c_defconfig
```kconfig
CONFIG_ARM=y
CONFIG_ARCH_PENTAGRAM=y
CONFIG_TARGET_PENTAGRAM_SP7350=y
CONFIG_SYS_ENV_SP7350_EVB=y
CONFIG_SRCADDR_KERNEL=0x2222
CONFIG_SRCADDR_DTB=0x2022
CONFIG_SRCADDR_NONOS=0x1822
CONFIG_SYS_TEXT_BASE=0x500000
CONFIG_SYS_MALLOC_F_LEN=0x40000
CONFIG_PHYS_64BIT=y
CONFIG_DEFAULT_DEVICE_TREE="sp7350-ev"
CONFIG_DEBUG_UART=y
CONFIG_BOOTDELAY=0
CONFIG_REGEX=y
CONFIG_CMD_BOOTZ=y
CONFIG_CMD_MD5SUM=y
CONFIG_MD5SUM_VERIFY=y
CONFIG_CMD_MEMINFO=y
CONFIG_CMD_GPT=y
CONFIG_CMD_GPT_RENAME=y
CONFIG_CMD_MMC=y
CONFIG_CMD_PART=y
CONFIG_CMD_USB=y
CONFIG_CMD_UUID=y
CONFIG_CMD_EXT2=y
CONFIG_CMD_FAT=y
CONFIG_CMD_EXT4=y
CONFIG_CMD_FS_GENERIC=y

CONFIG_OF_SEPARATE=y

CONFIG_CLK_CCF=y
CONFIG_CLK_COMPOSITE_CCF=y

CONFIG_ENV_IS_IN_MMC=y
CONFIG_ENV_OFFSET=0x304400
CONFIG_ENV_SIZE=0x20000
CONFIG_SYS_REDUNDAND_ENVIRONMENT=y
CONFIG_ENV_OFFSET_REDUND=0x384400
CONFIG_MMC=y
CONFIG_DM_MMC=y
CONFIG_MMC_SP_EMMC=y
CONFIG_MMC_SP_SD=y
CONFIG_SYS_ARCH_TIMER=y
# CONFIG_SP_TIMER is not set
CONFIG_DEBUG_UART_BASE=0x0
CONFIG_DEBUG_UART_CLOCK=90000
CONFIG_DEBUG_UART_SHIFT=2
CONFIG_SUNPLUS_SERIAL=y
#
# Soc
#
CONFIG_OTP_SUNPLUS=y
#
# Pin controllers & GPIO
#
CONFIG_PINCTRL_SUNPLUS_SP7350=y
CONFIG_CMD_GPIO=y
#
# Net
#
CONFIG_NET=y
CONFIG_NET_RANDOM_ETHADDR=y
#
# Network commands
#
CONFIG_CMD_NET=y
CONFIG_CMD_TFTPPUT=y
CONFIG_CMD_DHCP=y
CONFIG_CMD_PING=y

CONFIG_CMD_UNZIP=y
# CONFIG_CMD_TPS_MD is not set
# CONFIG_CMD_TPS_UPD is not set
# CONFIG_TPS_UPD_MMC is not set
# CONFIG_TPS_UPD_NAND is not set
# CONFIG_TPS_UPD_TFTP is not set
# CONFIG_TPS_UPD_USB is not set
# CONFIG_TFABOOT is not set
# CONFIG_SYS_ZMEM_SKIP_RELOC is not set

#
# Display
#
CONFIG_VIDEO_SP7350=n
CONFIG_DM_VIDEO_SP7350_LOGO=n
#
# Keyboard
#
CONFIG_USE_PREBOOT=n
CONFIG_DM_KEYBOARD=n
CONFIG_USB_KEYBOARD=n
#
# USB
#
CONFIG_DM_USB=y
CONFIG_USB=y
CONFIG_USB_EHCI_HCD=y
CONFIG_USB_EHCI_SUNPLUS=y
CONFIG_USB_OHCI_HCD=n
CONFIG_USB_OHCI_SUNPLUS=n
CONFIG_USB_XHCI_HCD=y
CONFIG_USB_XHCI_SPDWC3=y
CONFIG_USB_STORAGE=y
CONFIG_PHY=y
#
# SPI and I2C
#
CONFIG_DM_I2C=y
CONFIG_SPI=y
CONFIG_DM_SPI=y
CONFIG_DESIGNWARE_SPI=y
CONFIG_CMD_SPI=y
CONFIG_DEFAULT_SPI_BUS=0
CONFIG_DEFAULT_SPI_MODE=0
CONFIG_SYS_I2C_DW=y
CONFIG_CMD_I2C=y
#
# Android support commands
#
CONFIG_CMD_BOOTP=y
CONFIG_BOOTP_BOOTPATH=y
CONFIG_BOOTP_DNS=y
CONFIG_BOOTP_DNS2=y
CONFIG_BOOTP_GATEWAY=y
CONFIG_BOOTP_HOSTNAME=y
CONFIG_BOOTP_PREFER_SERVERIP=y
CONFIG_BOOTP_SUBNETMASK=y
CONFIG_BOOTP_NTPSERVER=y
# CONFIG_CMD_PCAP is not set
CONFIG_BOOTP_PXE=y
CONFIG_BOOTP_PXE_CLIENTARCH=0x16
CONFIG_BOOTP_VCI_STRING="U-Boot.armv8"
CONFIG_CMD_TFTPBOOT=y
CONFIG_CMD_TFTPSRV=y
CONFIG_NET_TFTP_VARS=y
# CONFIG_CMD_RARP is not set
CONFIG_CMD_NFS=y
CONFIG_CMD_MII=y
CONFIG_CMD_MDIO=y
# CONFIG_CMD_CDP is not set
# CONFIG_CMD_SNTP is not set
# CONFIG_CMD_DNS is not set
# CONFIG_CMD_LINK_LOCAL is not set
# CONFIG_CMD_ETHSW is not set
CONFIG_CMD_PXE=y
CONFIG_CMD_WOL=y
#
# Environment
#
CONFIG_PROT_UDP=y
CONFIG_BOOTP_SEND_HOSTNAME=y
# CONFIG_NETCONSOLE is not set
# CONFIG_IP_DEFRAG is not set
CONFIG_TFTP_BLOCKSIZE=1468
CONFIG_TFTP_WINDOWSIZE=1
CONFIG_SERVERIP_FROM_PROXYDHCP=y
CONFIG_SERVERIP_FROM_PROXYDHCP_DELAY_MS=100
#
# Ethernet & PHY
#
CONFIG_PHY_ADDR_ENABLE=y
CONFIG_PHY_ADDR=1
CONFIG_PHY_REALTEK=y
CONFIG_RTL8211F_PHY_FORCE_EEE_RXC_ON=y
CONFIG_DM_ETH=y
CONFIG_DM_MDIO=y
# CONFIG_DM_MDIO_MUX is not set
CONFIG_DM_ETH_PHY=y
CONFIG_PHY_GIGE=y
CONFIG_ETH_DESIGNWARE=y
CONFIG_RGMII=y
CONFIG_MII=y
```

## configs/sp7350_pnand_c_defconfig
```kconfig
CONFIG_ARM=y
CONFIG_ARCH_PENTAGRAM=y
CONFIG_TARGET_PENTAGRAM_SP7350=y
CONFIG_SYS_ENV_SP7350_EVB=y
CONFIG_SYS_TEXT_BASE=0x500000
CONFIG_SYS_MALLOC_F_LEN=0x40000
CONFIG_PHYS_64BIT=y
CONFIG_DEFAULT_DEVICE_TREE="sp7350-ev"
CONFIG_DEBUG_UART=y
CONFIG_BOOTDELAY=0
CONFIG_CMD_BOOTZ=y
CONFIG_CMD_MD5SUM=y
CONFIG_MD5SUM_VERIFY=y
CONFIG_CMD_MEMINFO=y
CONFIG_CMD_PART=y
CONFIG_CMD_USB=n

CONFIG_CMD_EXT2=y
CONFIG_CMD_FAT=y

CONFIG_CMD_MTDPARTS=y
CONFIG_OF_SEPARATE=y
CONFIG_CMD_DM=n
CONFIG_BOARD_LATE_INIT=n
CONFIG_CLK_CCF=y
CONFIG_CLK_COMPOSITE_CCF=y

CONFIG_SYS_ARCH_TIMER=y
# CONFIG_SP_TIMER is not set
# CONFIG_MMC is not set
CONFIG_MTD=y
CONFIG_DM_MTD=y
CONFIG_MTD_RAW_NAND=y
CONFIG_SP_PARANAND=y
# CONFIG_ENV_IS_IN_NAND is not set
CONFIG_ENV_OFFSET=0x600000
CONFIG_ENV_SIZE=0x20000
# CONFIG_SYS_REDUNDAND_ENVIRONMENT is not set
CONFIG_ENV_OFFSET_REDUND=0x680000
CONFIG_DEBUG_UART_BASE=0x0
CONFIG_DEBUG_UART_CLOCK=90000
CONFIG_DEBUG_UART_SHIFT=2
CONFIG_SUNPLUS_SERIAL=y
CONFIG_REGEX=y
#
# Soc
#
CONFIG_OTP_SUNPLUS=y
#
# Pin controllers & GPIO
#
CONFIG_PINCTRL_SUNPLUS_SP7350=y
CONFIG_CMD_GPIO=y
#
# Net
#
CONFIG_NETDEVICES=y
CONFIG_NET=n
CONFIG_LIB_RAND=y
CONFIG_NET_RANDOM_ETHADDR=y
#
# Network commands
#
CONFIG_CMD_NET=y
CONFIG_CMD_TFTPPUT=y
CONFIG_CMD_DHCP=y
CONFIG_CMD_UBI=y
CONFIG_CMD_UBIFS=y
CONFIG_CMD_PING=y
CONFIG_CMD_NAND=y

CONFIG_CMD_UNZIP=y
# CONFIG_CMD_TPS_MD is not set
# CONFIG_CMD_TPS_UPD is not set
# CONFIG_TPS_UPD_MMC is not set
# CONFIG_TPS_UPD_NAND is not set
# CONFIG_TPS_UPD_TFTP is not set
# CONFIG_TPS_UPD_USB is not set
# CONFIG_TFABOOT is not set
# CONFIG_SYS_ZMEM_SKIP_RELOC is not set

#
# Display
#
CONFIG_VIDEO_SP7350=n
CONFIG_DM_VIDEO_SP7350_LOGO=n
#
# Keyboard
#
CONFIG_USE_PREBOOT=n
CONFIG_DM_KEYBOARD=n
CONFIG_USB_KEYBOARD=n
#
# USB
#
CONFIG_USB=n
CONFIG_DM_USB=n
CONFIG_USB_EHCI_HCD=n
CONFIG_USB_EHCI_SUNPLUS=n
CONFIG_USB_OHCI_HCD=n
CONFIG_USB_OHCI_SUNPLUS=n
CONFIG_USB_STORAGE=y
#
# SPI and I2C
#
CONFIG_DM_I2C=y
CONFIG_DESIGNWARE_SPI=y
CONFIG_CMD_SPI=y
CONFIG_SYS_I2C_DW=y
CONFIG_CMD_I2C=y
```

## configs/sp7350_sdcard_c_defconfig
```kconfig
CONFIG_ARM=y
CONFIG_ARCH_PENTAGRAM=y
CONFIG_TARGET_PENTAGRAM_SP7350=y
CONFIG_SYS_ENV_SP7350_EVB=y
CONFIG_SYS_TEXT_BASE=0x500000
CONFIG_SYS_MALLOC_F_LEN=0x40000
CONFIG_PHYS_64BIT=y
CONFIG_DEFAULT_DEVICE_TREE="sp7350-ev"
CONFIG_DEBUG_UART=y
CONFIG_SD_BOOT=y
CONFIG_BOOTDELAY=0
CONFIG_REGEX=y
CONFIG_CMD_BOOTZ=y
CONFIG_CMD_MD5SUM=y
CONFIG_MD5SUM_VERIFY=y
CONFIG_CMD_MEMINFO=y
CONFIG_CMD_MMC=y
CONFIG_CMD_PART=y
CONFIG_CMD_USB=y
CONFIG_CMD_EXT2=y
CONFIG_CMD_FAT=y
CONFIG_CMD_EXT4=y
CONFIG_CMD_FS_GENERIC=y
CONFIG_CMD_PXE=y

CONFIG_OF_SEPARATE=y

CONFIG_CLK_CCF=y
CONFIG_CLK_COMPOSITE_CCF=y

CONFIG_SYS_ARCH_TIMER=y
# CONFIG_SP_TIMER is not set
CONFIG_DEBUG_UART_BASE=0x0
CONFIG_DEBUG_UART_CLOCK=90000
CONFIG_DEBUG_UART_SHIFT=2
CONFIG_SUNPLUS_SERIAL=y
CONFIG_MMC=y
CONFIG_DM_MMC=y
CONFIG_MMC_SP_SD=y
#
# Soc
#
CONFIG_OTP_SUNPLUS=y
#
# Pin controllers & GPIO
#
CONFIG_PINCTRL_SUNPLUS_SP7350=y
CONFIG_CMD_GPIO=y
#
# Net
#
CONFIG_NETDEVICES=y
CONFIG_NET=n
CONFIG_LIB_RAND=y
CONFIG_NET_RANDOM_ETHADDR=y
#
# Network commands
#
CONFIG_CMD_NET=y
CONFIG_CMD_TFTPPUT=y
CONFIG_CMD_DHCP=y
CONFIG_CMD_PING=y

CONFIG_CMD_UNZIP=y
# CONFIG_CMD_TPS_MD is not set
# CONFIG_CMD_TPS_UPD is not set
# CONFIG_TPS_UPD_MMC is not set
# CONFIG_TPS_UPD_NAND is not set
# CONFIG_TPS_UPD_TFTP is not set
# CONFIG_TPS_UPD_USB is not set
# CONFIG_TFABOOT is not set
# CONFIG_SYS_ZMEM_SKIP_RELOC is not set

#
# Display
#
CONFIG_VIDEO_SP7350=n
CONFIG_DM_VIDEO_SP7350_LOGO=n
#
# Keyboard
#
CONFIG_USE_PREBOOT=n
CONFIG_DM_KEYBOARD=n
CONFIG_USB_KEYBOARD=n
#
# USB
#
CONFIG_DM_USB=y
CONFIG_USB=y
CONFIG_USB_EHCI_HCD=y
CONFIG_USB_EHCI_SUNPLUS=y
CONFIG_USB_OHCI_HCD=n
CONFIG_USB_OHCI_SUNPLUS=n
CONFIG_USB_XHCI_HCD=y
CONFIG_USB_XHCI_SPDWC3=y
CONFIG_USB_STORAGE=y
CONFIG_PHY=y
#
# SPI and I2C
#
CONFIG_DM_I2C=y
CONFIG_SPI=y
CONFIG_DM_SPI=y
CONFIG_DESIGNWARE_SPI=y
CONFIG_CMD_SPI=y
CONFIG_DEFAULT_SPI_BUS=0
CONFIG_DEFAULT_SPI_MODE=0
CONFIG_SYS_I2C_DW=y
CONFIG_CMD_I2C=y
#
# Android support commands
#
CONFIG_CMD_NET=y
CONFIG_CMD_BOOTP=y
CONFIG_CMD_DHCP=y
CONFIG_BOOTP_BOOTPATH=y
CONFIG_BOOTP_DNS=y
CONFIG_BOOTP_DNS2=y
CONFIG_BOOTP_GATEWAY=y
CONFIG_BOOTP_HOSTNAME=y
CONFIG_BOOTP_PREFER_SERVERIP=y
CONFIG_BOOTP_SUBNETMASK=y
CONFIG_BOOTP_NTPSERVER=y
# CONFIG_CMD_PCAP is not set
CONFIG_BOOTP_PXE=y
CONFIG_BOOTP_PXE_CLIENTARCH=0x16
CONFIG_BOOTP_VCI_STRING="U-Boot.armv8"
CONFIG_CMD_TFTPBOOT=y
CONFIG_CMD_TFTPPUT=y
CONFIG_CMD_TFTPSRV=y
CONFIG_NET_TFTP_VARS=y
# CONFIG_CMD_RARP is not set
CONFIG_CMD_NFS=y
CONFIG_CMD_MII=y
CONFIG_CMD_MDIO=y
CONFIG_CMD_PING=y
# CONFIG_CMD_CDP is not set
# CONFIG_CMD_SNTP is not set
# CONFIG_CMD_DNS is not set
# CONFIG_CMD_LINK_LOCAL is not set
# CONFIG_CMD_ETHSW is not set
CONFIG_CMD_PXE=y
CONFIG_CMD_WOL=y
#
# Environment
#
CONFIG_NET=y
CONFIG_PROT_UDP=y
CONFIG_BOOTP_SEND_HOSTNAME=y
CONFIG_NET_RANDOM_ETHADDR=y
# CONFIG_NETCONSOLE is not set
# CONFIG_IP_DEFRAG is not set
CONFIG_TFTP_BLOCKSIZE=1468
CONFIG_TFTP_WINDOWSIZE=1
CONFIG_SERVERIP_FROM_PROXYDHCP=y
CONFIG_SERVERIP_FROM_PROXYDHCP_DELAY_MS=100
#
# Multiplexer drivers
#
CONFIG_PHYLIB=y
CONFIG_PHY_ADDR_ENABLE=y
CONFIG_PHY_ADDR=1
CONFIG_PHY_REALTEK=y
CONFIG_RTL8211F_PHY_FORCE_EEE_RXC_ON=y
CONFIG_DM_ETH=y
CONFIG_DM_MDIO=y
# CONFIG_DM_MDIO_MUX is not set
CONFIG_DM_ETH_PHY=y
CONFIG_NETDEVICES=y
CONFIG_PHY_GIGE=y
CONFIG_ETH_DESIGNWARE=y
CONFIG_RGMII=y
CONFIG_MII=y
```

## configs/sunplus_u54mc_defconfig
```kconfig
CONFIG_RISCV=y
CONFIG_TARGET_SUNPLUS_U54MC=y
CONFIG_RISCV_SMODE=y
CONFIG_ARCH_RV64I=y
CONFIG_DISTRO_DEFAULTS=y
CONFIG_NR_DRAM_BANKS=1
CONFIG_FIT=y
CONFIG_CMODEL_MEDANY=y
# CONFIG_USE_BOOTARGS is not set
# CONFIG_USE_BOOTCOMMAND is not set
# CONFIG_USE_PREBOOT is not set
CONFIG_DISPLAY_CPUINFO=y
CONFIG_DISPLAY_BOARDINFO=y
#CONFIG_USE_BOOTCOMMAND is not set
# CONFIG_MACB is not set
# CONFIG_CLK is not set
# CONFIG_SIFIVE_SERIAL is not set
# CONFIG_BITBANGMII is not set
CONFIG_SUNPLUS_SERIAL=y
CONFIG_DEFAULT_DEVICE_TREE="sunplus_u54mc"
CONFIG_SYS_TEXT_BASE=0xA0400000
CONFIG_OTP_SUNPLUS=y
CONFIG_SMP=y
CONFIG_OF_EMBED=y
```

## drivers/pinctrl/sunplus/Kconfig
```kconfig
config PINCTRL_SUNPLUS
	bool "Sunplus SP7021 Pinctrl and GPIO driver"
	depends on DM && (ARCH_PENTAGRAM && !TARGET_PENTAGRAM_Q645 && !TARGET_PENTAGRAM_SP7350)
	select PINCTRL
	select DM_GPIO
	default y
	help
	  Support pin configuration control on Sunplus's SP7021 SoC.

	  The driver is controlled by a device tree node which contains both
	  the GPIO definitions and pin control functions.

config PINCTRL_SUNPLUS_Q645
	bool "Sunplus Q645 Pinctrl and GPIO driver"
	depends on DM && TARGET_PENTAGRAM_Q645
	select PINCTRL
	select DM_GPIO
	default y
	help
	  Support pin configuration control on Sunplus's Q645 SoC.

	  The driver is controlled by a device tree node which contains both
	  the GPIO definitions and pin control functions.

config PINCTRL_SUNPLUS_SP7350
	bool "Sunplus SP7350 Pinctrl and GPIO driver"
	depends on DM && TARGET_PENTAGRAM_SP7350
	select PINCTRL
	select DM_GPIO
	default y
	help
	  Support pin configuration control on Sunplus's SP7350 SoC.

	  The driver is controlled by a device tree node which contains both
	  the GPIO definitions and pin control functions.
```

## drivers/video/sunplus/Kconfig
```kconfig
#
# Sunplus Video configuration
#

source "drivers/video/sunplus/sp7021/disp/Kconfig"
#source "drivers/video/sunplus/sp7021/mipi/Kconfig"
```

## drivers/video/sunplus/sp7350/disp/Kconfig
```kconfig
# SPDX-License-Identifier: GPL-2.0+
#
# Copyright (C) 2022 Sunplus - All Rights Reserved
#
# Authors: Hammer Hsieh <hammer.hsieh@sunplus.com>
#

menuconfig VIDEO_SP7350
	bool "Enable SP7350 video support"
	select DM_VIDEO
	select DM_GPIO
	select CMD_BMP
	select CMD_CLS
	# depends on DM_VIDEO
	# default y
	help
	  SP7350 supports MIPI DSI video output. This option enables
	  display function.

config EN_SP7350_MIPITX_SW
	bool "Enable SP7350 MIPITX switch to MIPI CSI TX"
	depends on DM_VIDEO && VIDEO_SP7350
	default n
	help
		Enable this will switch video output to MIPI CSI TX.

config SP7350_LT8912B_BRIDGE
	bool "Enable SP7350 LT8912B_HDMI bridge"
	depends on DM_VIDEO && VIDEO_SP7350
	default n
	help
		Enable this will init LT8912B_HDMI bridge via I2C6.

config VIDEO_SP7350_MAX_XRES
	int "Maximum horizontal resolution (for memory allocation purposes)"
	depends on VIDEO_SP7350
	default 720
	help
	  The maximum horizontal resolution to support for the framebuffer.
	  This configuration is used for reserving/allocating memory for the
	  framebuffer during device-model binding/probing.

config VIDEO_SP7350_MAX_YRES
	int "Maximum vertical resolution (for memory allocation purposes)"
	depends on VIDEO_SP7350
	default 480
	help
	  The maximum vertical resolution to support for the framebuffer.
	  This configuration is used for reserving/allocating memory for the
	  framebuffer during device-model binding/probing.

config VIDEO_SP7350_MAX_BPP
	int "Maximum bits per pixel (for memory allocation purposes)"
	depends on VIDEO_SP7350
	default 8
	help
	  The maximum bits per pixel to support for the framebuffer.
	  This configuration is used for reserving/allocating memory for the
	  framebuffer during device-model binding/probing.

config VIDEO_SP7350_ROTATE
	int "Console Text Rotate Angle Setting"
	depends on VIDEO_SP7350
	default 0
	help
	  Rotate angle 0: 0 degree / 1: 90 degree / 2: 180 degree / 3: 270 degree.

config BMP_8BPP_UPDATE_CMAP
	bool "Enable SP7350 Update Palette for 8BPP"
	depends on DM_VIDEO && VIDEO_SP7350
	default y
	help
		Allow 8BPP format update palette.

config DM_VIDEO_SP7350_LOGO
	bool "Enable SP7350 video LOGO support"
	depends on DM_VIDEO && VIDEO_SP7350
	default n
	help
		Logo display support

config DM_VIDEO_SP7350_LOGO_ALIGN
	bool "Align SP7350 video LOGO to center"
	depends on DM_VIDEO && VIDEO_SP7350
	default n
	help
		Logo display support , align to center

config VIDEO_BMP_LOGO_MANUAL
	bool "LOGO display by manual"
	depends on DM_VIDEO && VIDEO_SP7350
	default n
	help
		Logo display by manual
```
