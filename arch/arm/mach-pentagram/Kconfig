## arch/arm/mach-pentagram/Kconfig
```kconfig
if ARCH_PENTAGRAM

choice
	prompt "Board select"

config TARGET_PENTAGRAM_COMMON
	bool "SP7021 Board (C-chip)"
	select CPU_V7A
    #select CPU_V7_HAS_NONSEC
    #select CPU_V7_HAS_VIRT
	select ARCH_SUPPORT_PSCI
	select SYS_THUMB_BUILD

config TARGET_PENTAGRAM_B_BOOT
	bool "SP7021 Board (P-chip)"
	select CPU_ARM926EJS

config TARGET_PENTAGRAM_Q645
	bool "Q645 Board (Q645 C-chip)"
	select ARM64
	select ENABLE_ARM_SOC_BOOT0_HOOK

config TARGET_PENTAGRAM_SP7350
	bool "SP7350 Board (SP7350 C-chip)"
	select ARM64
	select ENABLE_ARM_SOC_BOOT0_HOOK

endchoice

choice
	prompt "Verification Environment"

config SYS_ENV_ZEBU
	bool "zebu environment"

config SYS_ENV_SP7021_EVB
	bool "sp7021 EVB"

config SYS_ENV_Q645_EVB
	bool "Q645 EVB"

config SYS_ENV_SP7350_EVB
	bool "SP7350 EVB"

endchoice

config SYS_ZMEM_SKIP_RELOC
	bool "zmem skip reloc"
	default y
	depends on SYS_ENV_ZEBU && !SD_BOOT && !NAND_BOOT

config SP_ZMEM_RELOC_ADDR
	hex "zmem reloc address"
	default 0x1F00000
	depends on SYS_ZMEM_SKIP_RELOC
	help
	  Fixed reloc address of u-boot on zmem environemnt.
	  This address is chosen by zmem firmware so follow
	  the zmem layout to assign this value. Zmem will
	  put the image with header on this address so the
	  first word of this address will be first 4 bytes
	  of header not the ENTRY() of text code.

config SP_TIMER
	bool "Sunplus timer"
	default y
	help
	  Support Sunplus STC timer

source "board/sunplus/q645/Kconfig"
source "board/sunplus/sp7350/Kconfig"
source "board/sunplus/pentagram_board/Kconfig"

endif
```

## board/sunplus/pentagram_board/Kconfig
```kconfig
if TARGET_PENTAGRAM_COMMON || TARGET_PENTAGRAM_B_BOOT

config SYS_CONFIG_NAME
	default "pentagram_common"

config SYS_SOC
	default "pentagram"

config SYS_BOARD
	default "pentagram_board"

config SYS_TEXT_BASE
	default 0x200040

config BOOTSCRIPT_SRAMBASE
        string "sram base"
        default 0x9e80fc00 if SYS_ENV_8388
        help
          sram base for querying boot mode

config BOOTSCRIPT_SRCADDR
        string "script source address"
        default 0x0 if SD_BOOT
        default 0x0 if NAND_BOOT
        default 0x98100000
        help
          boot script source address
          boot script image is stored in this
          address. bootcmd needs this address to
          load the image of boot script.

config BOOTSCRIPT_RAMADDR
        string "script ram address"
        default 0x0 if SD_BOOT
        default 0x0 if NAND_BOOT
        default 0x2C0000
        help
          boot script destination address
          boot script image will be loaded to
          this address. bootcmd uses "source"
          to execute boot script with this address.

config BOOTSCRIPT_SIZE
        string "script default size"
        default 0x400
        help
          boot script size
          bootcmd needs this value as size parameter
          to load image.

config HUSH_PARSER
	default y

endif
```

## board/sunplus/sp7350/Kconfig
```kconfig
if TARGET_PENTAGRAM_SP7350

config SYS_CONFIG_NAME
	default "pentagram_common_sp7350"

config SYS_SOC
	default "pentagram"

config SYS_BOARD
	default "sp7350"

config SYS_VENDOR
	default "sunplus"

config SYS_TEXT_BASE
	default 0x300040

config SYS_USE_QKBOOT_HEADER
	bool "use Sunpls quick boot header"
	default n
	help
	  Enable Sunplus quick boot header
	  Sunplus quick boot header is the same
	  as mkimage header. It also has 64 bytes
	  size with the same fields. We only change
	  crc and type in generic mkimage header.
	  It can speed up boot time. If enabled, we
	  replace mkimage header of kernel image and
	  also add sunplus-mkimage header on dtb image.

config SRCADDR_KERNEL
	hex "Linux kernel source address"
	default 0x0 if SD_BOOT
	default 0x0 if NAND_BOOT
	default 0xF0200000
	help
	  Linux kernel source address
	  Linux kernel image is stored in this
	  address. This address can be nand/emmc
	  address.

config SRCADDR_DTB
	hex "DTB source address"
	default 0x0 if SD_BOOT
	default 0x0 if NAND_BOOT
	default 0xF0040000
	help
	  DTB(device tree blob) source address
	  DTB image is stored in this address.
	  This address can be nand/emmc address.

config HUSH_PARSER
	default y

config SP_UTIL_MON
	bool "enable Sunplus mon util"
	default y
	help
	  Enable Sunplys mon util
	  It is useful to read/write Sunplus register
	  group.

config SP_JTAG
	bool "enable JTAG"
	help
	  Setup JTAG setting
	  For Cortex-M4, setup JTAG config and pinmux.

endif
```

## configs/pentagram_8388_defconfig
```kconfig
CONFIG_ARM=y
CONFIG_ARCH_PENTAGRAM=y
CONFIG_TARGET_PENTAGRAM_COMMON=y
CONFIG_DEFAULT_DEVICE_TREE="pentagram-common"
CONFIG_DEBUG_UART=y
# CONFIG_FIT is not set
CONFIG_BOOTDELAY=0
CONFIG_CMD_BOOTZ=y
# CONFIG_CMD_BOOTEFI is not set
# CONFIG_CMD_CRC32 is not set
# CONFIG_CMD_MEMORY is not set
CONFIG_CMD_PART=y
# CONFIG_CMD_NET is not set
# CONFIG_CMD_NFS is not set
CONFIG_CMD_EXT2=y
CONFIG_CMD_FAT=y
CONFIG_EFI_PARTITION=y
CONFIG_DEBUG_UART_BASE=0x0
CONFIG_DEBUG_UART_CLOCK=90000
CONFIG_DEBUG_UART_SHIFT=2
CONFIG_SUNPLUS_SERIAL=y
CONFIG_REGEX=y
```

## configs/q645_c_zmem_defconfig
```kconfig
CONFIG_ARM=y
CONFIG_ARCH_PENTAGRAM=y
CONFIG_TARGET_PENTAGRAM_Q645=y
CONFIG_SYS_TEXT_BASE=0x300000
CONFIG_SYS_MALLOC_F_LEN=0x40000
CONFIG_PHYS_64BIT=y
CONFIG_DEFAULT_DEVICE_TREE="q645-ev"
CONFIG_DEBUG_UART=y
CONFIG_BOOTDELAY=0
CONFIG_CMD_BOOTZ=y
CONFIG_CMD_MD5SUM=y
CONFIG_MD5SUM_VERIFY=y
CONFIG_CMD_MEMINFO=y
CONFIG_CMD_PART=y
CONFIG_CMD_USB=n

CONFIG_CLK_CCF=y
CONFIG_CLK_COMPOSITE_CCF=y
#CONFIG_LOGLEVEL=7

CONFIG_CMD_EXT2=y
CONFIG_CMD_FAT=y

CONFIG_OF_SEPARATE=y

CONFIG_DEVRES=y
CONFIG_DEBUG_DEVRES=y

# CONFIG_SYS_ARCH_TIMER is not set
# CONFIG_MMC is not set
CONFIG_DM_MMC=n
CONFIG_DEBUG_UART_BASE=0x0
CONFIG_DEBUG_UART_CLOCK=90000
CONFIG_DEBUG_UART_SHIFT=2
CONFIG_SUNPLUS_SERIAL=y
CONFIG_USB=n
# CONFIG_USB_EHCI_HCD is not set
CONFIG_REGEX=y
CONFIG_USB_STORAGE=y
#
# Soc
#
CONFIG_OTP_SUNPLUS=y
#
# Pin controllers & GPIO
#
CONFIG_PINCTRL_SUNPLUS_Q645=y
CONFIG_CMD_GPIO=y

CONFIG_SYS_ENV_ZEBU=y
CONFIG_CMD_UNZIP=y
# CONFIG_CMD_TPS_MD is not set
# CONFIG_CMD_TPS_UPD is not set
# CONFIG_TPS_UPD_MMC is not set
# CONFIG_TPS_UPD_NAND is not set
# CONFIG_TPS_UPD_TFTP is not set
# CONFIG_TPS_UPD_USB is not set
# CONFIG_TFABOOT is not set
# CONFIG_DM_VIDEO is not set
CONFIG_SYS_ZMEM_SKIP_RELOC=y
CONFIG_SP_ZMEM_RELOC_ADDR=0x3efffc0
```

## configs/q645_nand_c_defconfig
```kconfig
CONFIG_ARM=y
CONFIG_ARCH_PENTAGRAM=y
CONFIG_TARGET_PENTAGRAM_Q645=y
CONFIG_SYS_ENV_Q645_EVB=y
CONFIG_SYS_TEXT_BASE=0x300000
CONFIG_SYS_MALLOC_F_LEN=0x40000
CONFIG_PHYS_64BIT=y
CONFIG_DEFAULT_DEVICE_TREE="q645-ev"
CONFIG_DEBUG_UART=y
CONFIG_BOOTDELAY=0
CONFIG_CMD_BOOTZ=y
CONFIG_CMD_BOOTMENU=y
CONFIG_CMD_MD5SUM=y
CONFIG_MD5SUM_VERIFY=y
CONFIG_CMD_MEMINFO=y
CONFIG_CMD_MMC=y
CONFIG_CMD_PART=y
CONFIG_CMD_USB=y
CONFIG_CMD_EXT2=y
CONFIG_CMD_FAT=y
CONFIG_CMD_MTDPARTS=y

CONFIG_OF_SEPARATE=y

CONFIG_CLK_CCF=y
CONFIG_CLK_COMPOSITE_CCF=y

CONFIG_MMC_SP_SD=y
CONFIG_DM_MMC=y

# CONFIG_SYS_ARCH_TIMER is not set
CONFIG_MTD=y
CONFIG_DM_MTD=y
CONFIG_MTD_RAW_NAND=y
CONFIG_SP_SPINAND_Q645=y
CONFIG_ENV_IS_IN_NAND=y
CONFIG_ENV_OFFSET=0x400000
CONFIG_ENV_SIZE=0x20000
CONFIG_SYS_REDUNDAND_ENVIRONMENT=y
CONFIG_ENV_OFFSET_REDUND=0x480000
CONFIG_DEBUG_UART_BASE=0x0
CONFIG_DEBUG_UART_CLOCK=90000
CONFIG_DEBUG_UART_SHIFT=2
CONFIG_SUNPLUS_SERIAL=y
CONFIG_DM_USB=y
CONFIG_USB=y
CONFIG_PHY=y
CONFIG_USB_XHCI_HCD=y
CONFIG_USB_XHCI_SPDWC3=y
# CONFIG_USB_EHCI_HCD is not set
CONFIG_REGEX=y
CONFIG_USB_STORAGE=y
#
# Soc
#
CONFIG_OTP_SUNPLUS=y
#
# Pin controllers & GPIO
#
CONFIG_PINCTRL_SUNPLUS_Q645=y
CONFIG_CMD_GPIO=y
#
# Net
#
CONFIG_NETDEVICES=y
CONFIG_NET=n
CONFIG_LIB_RAND=y
CONFIG_NET_RANDOM_ETHADDR=y
#
# Network commands
#
CONFIG_CMD_NET=y
CONFIG_CMD_TFTPPUT=y
CONFIG_CMD_DHCP=y
CONFIG_CMD_UBI=y
CONFIG_CMD_UBIFS=y
CONFIG_CMD_PING=y
CONFIG_CMD_NAND=y

CONFIG_CMD_UNZIP=y
# CONFIG_CMD_TPS_MD is not set
# CONFIG_CMD_TPS_UPD is not set
# CONFIG_TPS_UPD_MMC is not set
# CONFIG_TPS_UPD_NAND is not set
# CONFIG_TPS_UPD_TFTP is not set
# CONFIG_TPS_UPD_USB is not set
# CONFIG_TFABOOT is not set
# CONFIG_DM_VIDEO is not set
# CONFIG_SYS_ZMEM_SKIP_RELOC is not set
```

## configs/q645_usb_c_defconfig
```kconfig
CONFIG_ARM=y
CONFIG_ARCH_PENTAGRAM=y
CONFIG_TARGET_PENTAGRAM_Q645=y
CONFIG_SYS_ENV_Q645_EVB=y
CONFIG_SYS_TEXT_BASE=0x300000
CONFIG_SYS_MALLOC_F_LEN=0x40000
CONFIG_PHYS_64BIT=y
CONFIG_DEFAULT_DEVICE_TREE="q645-ev"
CONFIG_DEBUG_UART=y
CONFIG_BOOTDELAY=0
CONFIG_CMD_BOOTZ=y
CONFIG_CMD_MD5SUM=y
CONFIG_MD5SUM_VERIFY=y
CONFIG_CMD_MEMINFO=y
CONFIG_CMD_PART=y
CONFIG_CMD_USB=n

CONFIG_CMD_EXT2=y
CONFIG_CMD_FAT=y

CONFIG_OF_SEPARATE=y

CONFIG_DEVRES=y
CONFIG_DEBUG_DEVRES=y

# CONFIG_SYS_ARCH_TIMER is not set
# CONFIG_SP_UTIL_MON is not set
# CONFIG_SP_JTAG is not set
# CONFIG_MMC is not set
CONFIG_DM_MMC=n
CONFIG_DEBUG_UART_BASE=0x0
CONFIG_DEBUG_UART_CLOCK=90000
CONFIG_DEBUG_UART_SHIFT=2
CONFIG_SUNPLUS_SERIAL=y
CONFIG_USB=n
# CONFIG_USB_EHCI_HCD is not set
CONFIG_REGEX=y
CONFIG_USB_STORAGE=y
#
# Soc
#
CONFIG_OTP_SUNPLUS=y
#
# Pin controllers
#
CONFIG_PINCTRL=y
CONFIG_PINCTRL_FULL=y
CONFIG_PINCTRL_GENERIC=y
CONFIG_PINMUX=y
CONFIG_PINCTRL_SUNPLUS_Q645=y
CONFIG_CMD_GPIO=y
#
# Net
#
CONFIG_NETDEVICES=y
CONFIG_NET=n
CONFIG_LIB_RAND=y
CONFIG_NET_RANDOM_ETHADDR=y
#
# Network commands
#
CONFIG_CMD_NET=y
CONFIG_CMD_TFTPPUT=y
CONFIG_CMD_DHCP=y
CONFIG_CMD_PING=y

CONFIG_CMD_UNZIP=y
# CONFIG_CMD_TPS_MD is not set
# CONFIG_CMD_TPS_UPD is not set
# CONFIG_TPS_UPD_MMC is not set
# CONFIG_TPS_UPD_NAND is not set
# CONFIG_TPS_UPD_TFTP is not set
# CONFIG_TPS_UPD_USB is not set
# CONFIG_TFABOOT is not set
# CONFIG_DM_VIDEO is not set
# CONFIG_SYS_ZMEM_SKIP_RELOC is not set
```

## configs/q654_nor_c_defconfig
```kconfig
CONFIG_ARM=y
CONFIG_ARCH_PENTAGRAM=y
CONFIG_TARGET_PENTAGRAM_Q654=y
CONFIG_SYS_ENV_Q654_EVB=y
CONFIG_SYS_TEXT_BASE=0x300000
CONFIG_SYS_MALLOC_F_LEN=0x40000
CONFIG_PHYS_64BIT=y
CONFIG_DEFAULT_DEVICE_TREE="q654-ev"
CONFIG_DEBUG_UART=y
CONFIG_BOOTDELAY=0
CONFIG_CMD_BOOTZ=y
CONFIG_CMD_MD5SUM=y
CONFIG_MD5SUM_VERIFY=y
CONFIG_CMD_MEMINFO=y
CONFIG_CMD_MMC=y
CONFIG_CMD_PART=y
CONFIG_CMD_USB=y

CONFIG_CMD_EXT2=y
CONFIG_CMD_FAT=y

CONFIG_OF_SEPARATE=y

CONFIG_DEVRES=y
CONFIG_DEBUG_DEVRES=y

CONFIG_MMC=y
CONFIG_DM_MMC=y
CONFIG_MTD=y
CONFIG_DM_SPI_FLASH=y
CONFIG_SPI_FLASH=y
CONFIG_SPI_FLASH_SUNPLUS=y
# CONFIG_SPI_FLASH_USE_4K_SECTORS is not set
CONFIG_SPI=y
CONFIG_DM_SPI=y
CONFIG_SUNPLUS_SPI_NOR=y
CONFIG_SF_DEFAULT_SPEED=25000000
# CONFIG_SYS_ARCH_TIMER is not set
# CONFIG_SP_UTIL_MON is not set
# CONFIG_SP_JTAG is not set
CONFIG_DEBUG_UART_BASE=0x0
CONFIG_DEBUG_UART_CLOCK=90000
CONFIG_DEBUG_UART_SHIFT=2
CONFIG_SUNPLUS_SERIAL=y
CONFIG_USB=y
CONFIG_DM_USB=y
# CONFIG_USB_EHCI_HCD is not set
CONFIG_USB_STORAGE=y
CONFIG_REGEX=y
#
# Soc
#
CONFIG_OTP_SUNPLUS=y
#
# Pin controllers
#
CONFIG_PINCTRL=y
CONFIG_PINCTRL_FULL=y
CONFIG_PINCTRL_GENERIC=y
CONFIG_PINMUX=y
CONFIG_PINCTRL_SUNPLUS_Q654=y
#
# Net
#
CONFIG_DM_ETH=n
CONFIG_NETDEVICES=n
CONFIG_NET=n
CONFIG_LIB_RAND=y
CONFIG_NET_RANDOM_ETHADDR=y
#
# Network commands
#
CONFIG_CMD_NET=y
CONFIG_CMD_TFTPPUT=y
CONFIG_CMD_DHCP=y
CONFIG_CMD_PING=y
CONFIG_CMD_UNZIP=y
CONFIG_CMD_SF=y
# CONFIG_CMD_TPS_MD is not set
# CONFIG_CMD_TPS_UPD is not set
# CONFIG_TPS_UPD_MMC is not set
# CONFIG_TPS_UPD_NAND is not set
# CONFIG_TPS_UPD_TFTP is not set
# CONFIG_TPS_UPD_USB is not set
# CONFIG_TFABOOT is not set
# CONFIG_DM_VIDEO is not set
# CONFIG_SYS_ZMEM_SKIP_RELOC is not set
```

## configs/sp7350_c_zmem_defconfig
```kconfig
CONFIG_ARM=y
CONFIG_ARCH_PENTAGRAM=y
CONFIG_TARGET_PENTAGRAM_SP7350=y
CONFIG_SYS_TEXT_BASE=0x500000
CONFIG_SYS_MALLOC_F_LEN=0x40000
CONFIG_PHYS_64BIT=y
CONFIG_DEFAULT_DEVICE_TREE="sp7350-ev"
CONFIG_DEBUG_UART=y
CONFIG_BOOTDELAY=0
CONFIG_CMD_BOOTZ=y
CONFIG_CMD_MD5SUM=y
CONFIG_MD5SUM_VERIFY=y
CONFIG_CMD_MEMINFO=y
CONFIG_CMD_PART=y
CONFIG_CMD_USB=n

CONFIG_CMD_EXT2=y
CONFIG_CMD_FAT=y

CONFIG_OF_SEPARATE=y
CONFIG_CLK_CCF=y
CONFIG_CLK_COMPOSITE_CCF=y

CONFIG_SYS_ARCH_TIMER=y
# CONFIG_SP_TIMER is not set
# CONFIG_MMC is not set
CONFIG_DM_MMC=n
CONFIG_DEBUG_UART_BASE=0x0
CONFIG_DEBUG_UART_CLOCK=90000
CONFIG_DEBUG_UART_SHIFT=2
CONFIG_SUNPLUS_SERIAL=y
CONFIG_REGEX=y
#
# Soc
#
CONFIG_OTP_SUNPLUS=y
#
# Pin controllers & GPIO
#
CONFIG_PINCTRL_SUNPLUS_SP7350=y
CONFIG_CMD_GPIO=y

CONFIG_SYS_ENV_ZEBU=y
CONFIG_CMD_UNZIP=y
# CONFIG_CMD_TPS_MD is not set
# CONFIG_CMD_TPS_UPD is not set
# CONFIG_TPS_UPD_MMC is not set
# CONFIG_TPS_UPD_NAND is not set
# CONFIG_TPS_UPD_TFTP is not set
# CONFIG_TPS_UPD_USB is not set
# CONFIG_TFABOOT is not set
CONFIG_SYS_ZMEM_SKIP_RELOC=y
CONFIG_SP_ZMEM_RELOC_ADDR=0xfefffc0

CONFIG_CMD_DM=n
CONFIG_BOARD_LATE_INIT=n
#
# Display
#
CONFIG_VIDEO_SP7350=n
CONFIG_DM_VIDEO_SP7350_LOGO=n
#
# Keyboard
#
CONFIG_USE_PREBOOT=n
CONFIG_DM_KEYBOARD=n
CONFIG_USB_KEYBOARD=n
#
# USB
#
CONFIG_USB=n
CONFIG_DM_USB=n
CONFIG_USB_EHCI_HCD=n
CONFIG_USB_EHCI_SUNPLUS=n
CONFIG_USB_OHCI_HCD=n
CONFIG_USB_OHCI_SUNPLUS=n
CONFIG_USB_STORAGE=y
#
# SPI and I2C
#
CONFIG_DM_I2C=y
CONFIG_SPI=y
CONFIG_DM_SPI=y
CONFIG_DESIGNWARE_SPI=y
CONFIG_CMD_SPI=y
CONFIG_DEFAULT_SPI_BUS=0
CONFIG_DEFAULT_SPI_MODE=0
CONFIG_SYS_I2C_DW=y
CONFIG_CMD_I2C=y
```
