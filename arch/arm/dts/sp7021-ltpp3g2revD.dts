// SPDX-License-Identifier: GPL-2.0
/*
 * Device Tree Source (include) for LTPP3G2 Rev.D on SP7021 SoC
 *
 * Copyright (C) 2021 Tibbo Technology Inc.
 */

/dts-v1/;

#include "sp7021-ltpp3g2revD.dtsi"

/ {
	model = "LTPP3G2 Rev.D on SP7021 (empty sockets)";
};
