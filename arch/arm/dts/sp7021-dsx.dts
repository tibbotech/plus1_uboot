// SPDX-License-Identifier: GPL-2.0
/*
 * Device Tree Source (include) for DSX Rev.A on SP7021 SoC
 *
 * Copyright (C) 2021 Tibbo Technology Inc.
 */

/dts-v1/;

#include "sp7021-dsx.dtsi"

/ {
	model = "DSX Rev.A on SP7021";
};
